## tests/zephyr/testcase.yaml
```yaml
# SPDX-License-Identifier: Apache-2.0
# Zephyr Test Case Metadata for MicroLA

tests:
  libraries.microla.all:
    platform_allow:
      - qemu_cortex_m3
      - qemu_cortex_m0
      - qemu_cortex_a53
    tags:
      - library
      - math
      - microla
    harness: console
    harness_config:
      type: multi_line
      ordered: false
      regex:
        - "TESTSUITE microla_vector"
        - "TESTSUITE microla_matrix"
        - "TESTSUITE microla_quaternion"
        - "TESTSUITE microla_integration"
    integration_platforms:
      - qemu_cortex_m3
    min_ram: 32
    min_flash: 64

  libraries.microla.all.native:
    extra_args: "CONF_FILE=prj_native_sim.conf"
    platform_allow:
      - native_sim
    tags:
      - library
      - math
      - microla
    harness: console
    harness_config:
      type: multi_line
      ordered: false
      regex:
        - "TESTSUITE microla_vector"
        - "TESTSUITE microla_matrix"
        - "TESTSUITE microla_quaternion"
        - "TESTSUITE microla_integration"
    integration_platforms:
      - native_sim
    min_ram: 32
    min_flash: 64

  libraries.microla.renode_nrf52840:
    platform_allow:
      - nrf52840dk/nrf52840
    tags:
      - library
      - math
      - microla
      - renode
    harness: console
    harness_config:
      type: multi_line
      ordered: false
      regex:
        - "TESTSUITE microla_vector"
        - "TESTSUITE microla_matrix"
        - "TESTSUITE microla_quaternion"
        - "TESTSUITE microla_integration"
        - "PROJECT EXECUTION SUCCESSFUL"
    integration_platforms:
      - nrf52840dk/nrf52840
    min_ram: 64
    min_flash: 256
```

## zephyr/Kconfig
```kconfig
# Copyright (c) 2026 MicroLA Contributors
# SPDX-License-Identifier: MIT

config MICROLA
	bool "MicroLA - Linear Algebra Library"
	help
	  Enable MicroLA header-only linear algebra library.
	  Provides Vec, Mat, SquareMat, and Quaternion classes
	  optimized for embedded systems.

if MICROLA

config MICROLA_DEBUG
	bool "Enable debug assertions and bounds checking"
	default n
	help
	  Enable runtime assertions and bounds checking in MicroLA.
	  When enabled, the at() accessor methods will perform bounds
	  checking using assert() in debug builds. This adds minimal
	  overhead but helps catch out-of-bounds access during development.
	  Recommended for development and testing, disable for production.

config MICROLA_NEON
	bool "Enable ARM NEON optimizations"
	depends on CPU_CORTEX_A || ARM64
	help
	  Enable ARM NEON SIMD acceleration for vector, matrix,
	  and quaternion operations on ARM Cortex-A processors
	  and ARM64 platforms (including Apple Silicon).
	  Provides significant performance improvements for
	  float32 operations on vectors of size 2, 3, and 4.
	  Also defines MICROLA_ENABLE_NEON for compatibility
	  with non-Zephyr build switches.

config MICROLA_CMSIS
	bool "Enable CMSIS-DSP optimizations"
	depends on CMSIS_DSP
	help
	  Enable CMSIS-DSP hardware acceleration for vector,
	  matrix, and quaternion operations on ARM Cortex-M
	  processors. Requires CMSIS-DSP to be enabled.
	  Also defines MICROLA_ENABLE_CMSIS for compatibility
	  with non-Zephyr build switches.

config MICROLA_MVE
	bool "Enable ARM MVE (Helium) optimizations"
	depends on CPU_CORTEX_M
	help
	  Enable ARM MVE (Helium) SIMD acceleration for vector,
	  matrix, and quaternion operations on Cortex-M processors
	  that support MVE. This option is intended for Cortex-M
	  profiles with Helium extensions.
	  Also defines MICROLA_ENABLE_MVE for compatibility
	  with non-Zephyr build switches.

endif # MICROLA
```
