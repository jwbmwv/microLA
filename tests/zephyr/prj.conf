## CMakeLists.txt
```
# SPDX-License-Identifier: Apache-2.0
# CMakeLists.txt for MicroLA Zephyr Tests

cmake_minimum_required(VERSION 3.20.0)

# Find Zephyr package (must be called before project())
find_package(Zephyr REQUIRED HINTS $ENV{ZEPHYR_BASE})

project(microla_tests)

# Add MicroLA include directory
target_include_directories(app PRIVATE ${CMAKE_CURRENT_SOURCE_DIR}/../../include)

# Add test source files
target_sources(app PRIVATE
    src/main.c
    src/test_vector.cpp
        src/test_vector_view.cpp
    src/test_matrix.cpp
    src/test_quaternion.cpp
    src/test_integration.cpp
    src/test_matrix_view.cpp
)

# Enable C++20 for MicroLA
set_property(TARGET app PROPERTY CXX_STANDARD 20)
set_property(TARGET app PROPERTY CXX_STANDARD_REQUIRED ON)
```

## prj.conf
```kconfig
# SPDX-License-Identifier: Apache-2.0
# Zephyr Project Configuration for MicroLA Tests

# Enable MicroLA library
CONFIG_MICROLA=y

# Enable Ztest framework
CONFIG_ZTEST=y

# Increase main stack size for tests
CONFIG_MAIN_STACK_SIZE=4096

# Increase system heap for dynamic allocations in tests
CONFIG_HEAP_MEM_POOL_SIZE=16384

# Enable C++ support
CONFIG_CPP=y
CONFIG_STD_CPP20=y
CONFIG_CPP_EXCEPTIONS=n
CONFIG_CPP_RTTI=n
CONFIG_REQUIRES_FULL_LIBCPP=y

# Enable newlib for better C++ standard library support
CONFIG_NEWLIB_LIBC=y

# Debug options (optional, can be disabled for flash/RAM optimization)
CONFIG_DEBUG=y

# Logging (optional)
CONFIG_LOG=y
CONFIG_LOG_DEFAULT_LEVEL=3

# Console/UART for test output
CONFIG_CONSOLE=y
CONFIG_UART_CONSOLE=y
CONFIG_SERIAL=y

# Optional: Enable CMSIS-DSP for ARM Cortex-M (uncomment if available)
# CONFIG_CMSIS_DSP=y
# CONFIG_MICROLA_CMSIS=y

# Optional: Enable NEON for ARM Cortex-A/ARM64 (uncomment if supported)
# CONFIG_MICROLA_NEON=y

# Optional: Enable MVE for ARM Cortex-M with Helium (uncomment if supported)
# CONFIG_MICROLA_MVE=y
```

## prj_minimal.conf
```kconfig
# SPDX-License-Identifier: Apache-2.0
# Alternative configuration for optimized builds (smaller footprint)

# Enable MicroLA library
CONFIG_MICROLA=y

# Enable Ztest framework
CONFIG_ZTEST=y

# Reduce stack size for constrained devices
CONFIG_MAIN_STACK_SIZE=2048

# Reduce heap size
CONFIG_HEAP_MEM_POOL_SIZE=8192

# Enable C++ support
CONFIG_CPP=y
CONFIG_STD_CPP20=y
CONFIG_CPP_EXCEPTIONS=n
CONFIG_CPP_RTTI=n
CONFIG_REQUIRES_FULL_LIBCPP=y

# Use minimal libc for embedded
CONFIG_MINIMAL_LIBC=y

# Enable floating point support
CONFIG_FPU=y

# Disable debug options to save space
CONFIG_DEBUG=n
CONFIG_DEBUG_INFO=n

# Minimal logging
CONFIG_LOG=n

# Console for test output
CONFIG_CONSOLE=y
CONFIG_UART_CONSOLE=y
CONFIG_SERIAL=y

# Optimize for size
CONFIG_SIZE_OPTIMIZATIONS=y
CONFIG_COMPILER_OPT="-Os"
```

## prj_native_sim.conf
```kconfig
# SPDX-License-Identifier: Apache-2.0
# Zephyr Project Configuration for MicroLA Tests (native_sim)

# Enable MicroLA library
CONFIG_MICROLA=y

# Enable Ztest framework
CONFIG_ZTEST=y

# Increase main stack size for tests
CONFIG_MAIN_STACK_SIZE=4096

# Increase system heap for dynamic allocations in tests
CONFIG_HEAP_MEM_POOL_SIZE=16384

# Enable C++ support
CONFIG_CPP=y
CONFIG_STD_CPP20=y
CONFIG_CPP_EXCEPTIONS=n
CONFIG_CPP_RTTI=n
CONFIG_REQUIRES_FULL_LIBCPP=y

# Console/UART for test output
CONFIG_CONSOLE=y
CONFIG_UART_CONSOLE=y
CONFIG_SERIAL=y
```

## prj_simd.conf
```kconfig
# SPDX-License-Identifier: Apache-2.0
# Configuration with SIMD optimizations enabled

# Enable MicroLA library
CONFIG_MICROLA=y

# Enable Ztest framework
CONFIG_ZTEST=y

# Stack and heap
CONFIG_MAIN_STACK_SIZE=4096
CONFIG_HEAP_MEM_POOL_SIZE=16384

# Enable C++ support
CONFIG_CPP=y
CONFIG_STD_CPP20=y
CONFIG_CPP_EXCEPTIONS=n
CONFIG_CPP_RTTI=n
CONFIG_REQUIRES_FULL_LIBCPP=y

# Enable newlib for better C++ support
CONFIG_NEWLIB_LIBC=y
CONFIG_NEWLIB_LIBC_FLOAT_PRINTF=y
CONFIG_NEWLIB_LIBC_FLOAT_SCANF=y

# Floating point support
CONFIG_FPU=y

# Enable CMSIS-DSP for ARM Cortex-M
CONFIG_CMSIS_DSP=y
CONFIG_CMSIS_DSP_BASICMATH=y
CONFIG_CMSIS_DSP_FASTMATH=y
CONFIG_CMSIS_DSP_MATRIX=y
CONFIG_MICROLA_CMSIS=y

# Debug options
CONFIG_DEBUG=y

# Logging
CONFIG_LOG=y
CONFIG_LOG_DEFAULT_LEVEL=3

# Console
CONFIG_CONSOLE=y
CONFIG_UART_CONSOLE=y
CONFIG_SERIAL=y

# Optimize for speed
CONFIG_SPEED_OPTIMIZATIONS=y
```

## src/main.c
```c
// SPDX-License-Identifier: Apache-2.0
/// @file main.c
/// @brief Main entry point for MicroLA Zephyr tests
/// @copyright Copyright (c) 2026 James Baldwin. AI-assisted — see NOTICE.

#include <zephyr/kernel.h>
#include <zephyr/ztest.h>

/**
 * @brief Main function - runs all test suites
 *
 * This file serves as the entry point for the Zephyr test framework.
 * All test suites are automatically discovered and executed by ztest.
 *
 * Test suites included:
 * - microla_vector: Vector operations tests
 * - microla_matrix: Matrix operations tests
 * - microla_quaternion: Quaternion operations tests
 * - microla_integration: Integration and combined functionality tests
 */

// The ztest framework will automatically discover and run all test suites
// No additional code needed here - test suites are registered in their respective files
```

## src/test_integration.cpp
```c
// SPDX-License-Identifier: MIT
/// @file test_integration.cpp
/// @brief Zephyr ztest integration tests for MicroLA
/// @copyright Copyright (c) 2026 James Baldwin

#include <zephyr/ztest.h>
#include <microla/microla.hpp>
#include <cmath>

using namespace microla;

static const float epsilon = 1e-4f;
static const float PI = 3.14159265358979323846f;

// Helper function for floating point comparison
static bool float_eq(float a, float b, float eps = epsilon)
{
    return std::fabs(a - b) < eps;
}

// ===== Graphics Pipeline Integration Tests =====

ZTEST(microla_integration, test_transform_pipeline)
{
    // Create a simple graphics transform pipeline:
    // Translation -> Rotation -> Scaling

    // 1. Start with a point
    Vec<float, 3> point(1.0f, 0.0f, 0.0f);

    // 2. Create a rotation quaternion (90 degrees around Z)
    Vec<float, 3> axis(0.0f, 0.0f, 1.0f);
    Quaternion<float> rotation = Quaternion<float>::from_axis_angle(axis, PI / 2.0f);

    // 3. Apply rotation
    Vec<float, 3> rotated = rotation.rotate(point);

    // Should be approximately (0, 1, 0)
    zassert_true(float_eq(rotated.x(), 0.0f), "Transform pipeline x failed");
    zassert_true(float_eq(rotated.y(), 1.0f), "Transform pipeline y failed");
    zassert_true(float_eq(rotated.z(), 0.0f), "Transform pipeline z failed");

    // 4. Apply scaling
    Vec<float, 3> scaled = rotated * 2.0f;

    // Should be approximately (0, 2, 0)
    zassert_true(float_eq(scaled.x(), 0.0f), "Scaled x failed");
    zassert_true(float_eq(scaled.y(), 2.0f), "Scaled y failed");
    zassert_true(float_eq(scaled.z(), 0.0f), "Scaled z failed");
}

ZTEST(microla_integration, test_coordinate_system_transformation)
{
    // Test converting between coordinate systems using matrices

    // Create a simple 2D rotation matrix (45 degrees)
    float angle = PI / 4.0f;  // 45 degrees
    float cos_a = std::cos(angle);
    float sin_a = std::sin(angle);

    Mat<float, 2, 2> rotation{cos_a, -sin_a, sin_a, cos_a};

    // Rotate unit X vector
    Vec<float, 2> v(1.0f, 0.0f);
    Vec<float, 2> rotated = rotation * v;

    // Should be approximately (0.707, 0.707)
    zassert_true(float_eq(rotated.x(), cos_a), "Coord transform x failed");
    zassert_true(float_eq(rotated.y(), sin_a), "Coord transform y failed");
}

// ===== Robotics Kinematics Integration Tests =====

ZTEST(microla_integration, test_forward_kinematics)
{
    // Simple 2-link planar robot arm forward kinematics
    // Link 1: length 1.0, angle 0°
    // Link 2: length 1.0, angle 90°

    float l1 = 1.0f;
    float l2 = 1.0f;
    float theta1 = 0.0f;
    float theta2 = PI / 2.0f;

    // End effector position
    Vec<float, 2> end_effector;
    end_effector[0] = l1 * std::cos(theta1) + l2 * std::cos(theta1 + theta2);
    end_effector[1] = l1 * std::sin(theta1) + l2 * std::sin(theta1 + theta2);

    // Should be approximately (1.0, 1.0)
    zassert_true(float_eq(end_effector.x(), 1.0f), "Forward kinematics x failed");
    zassert_true(float_eq(end_effector.y(), 1.0f), "Forward kinematics y failed");
}

ZTEST(microla_integration, test_quaternion_chain)
{
    // Test chaining multiple rotations
    Vec<float, 3> axis_z(0.0f, 0.0f, 1.0f);
    Vec<float, 3> axis_y(0.0f, 1.0f, 0.0f);

    // 90 degree rotation around Z
    Quaternion<float> q1 = Quaternion<float>::from_axis_angle(axis_z, PI / 2.0f);

    // 90 degree rotation around Y
    Quaternion<float> q2 = Quaternion<float>::from_axis_angle(axis_y, PI / 2.0f);

    // Combined rotation
    Quaternion<float> combined = q2 * q1;

    // Apply to unit X vector
    Vec<float, 3> v(1.0f, 0.0f, 0.0f);
    Vec<float, 3> result = combined.rotate(v);

    // Result should be a valid rotated vector
    float mag = result.magnitude();
    zassert_true(float_eq(mag, 1.0f), "Quaternion chain should preserve magnitude");
}

// ===== Sensor Fusion Integration Tests =====

ZTEST(microla_integration, test_weighted_average)
{
    // Simulate sensor fusion by weighted averaging
    Vec<float, 3> sensor1(1.0f, 2.0f, 3.0f);
    Vec<float, 3> sensor2(2.0f, 3.0f, 4.0f);

    float weight1 = 0.7f;
    float weight2 = 0.3f;

    Vec<float, 3> fused = sensor1 * weight1 + sensor2 * weight2;

    // Expected: (1.0*0.7 + 2.0*0.3, 2.0*0.7 + 3.0*0.3, 3.0*0.7 + 4.0*0.3)
    //         = (1.3, 2.3, 3.3)
    zassert_true(float_eq(fused.x(), 1.3f), "Sensor fusion x failed");
    zassert_true(float_eq(fused.y(), 2.3f), "Sensor fusion y failed");
    zassert_true(float_eq(fused.z(), 3.3f), "Sensor fusion z failed");
}

ZTEST(microla_integration, test_motion_prediction)
{
    // Simple linear motion prediction: new_pos = pos + velocity * dt
    Vec<float, 3> position(1.0f, 2.0f, 3.0f);
    Vec<float, 3> velocity(0.5f, 1.0f, 1.5f);
    float dt = 2.0f;

    Vec<float, 3> predicted = position + velocity * dt;

    // Expected: (1 + 0.5*2, 2 + 1.0*2, 3 + 1.5*2) = (2, 4, 6)
    zassert_true(float_eq(predicted.x(), 2.0f), "Motion prediction x failed");
    zassert_true(float_eq(predicted.y(), 4.0f), "Motion prediction y failed");
    zassert_true(float_eq(predicted.z(), 6.0f), "Motion prediction z failed");
}

// ===== Physics Integration Tests =====

ZTEST(microla_integration, test_reflection_vector)
{
    // Test vector reflection (like light bouncing off a surface)
    // R = V - 2(V·N)N, where N is the surface normal

    Vec<float, 3> incident(1.0f, -1.0f, 0.0f);  // Ray coming down at 45°
    Vec<float, 3> normal(0.0f, 1.0f, 0.0f);     // Horizontal surface (up)

    float dot_vn = incident.dot(normal);
    Vec<float, 3> reflected = incident - normal * (2.0f * dot_vn);

    // Should reflect symmetrically
    zassert_true(float_eq(reflected.x(), 1.0f), "Reflection x failed");
    zassert_true(float_eq(reflected.y(), 1.0f), "Reflection y failed");
    zassert_true(float_eq(reflected.z(), 0.0f), "Reflection z failed");
}

ZTEST(microla_integration, test_projectile_motion)
{
    // Calculate projectile position: p = p0 + v*t + 0.5*a*t^2
    Vec<float, 3> p0(0.0f, 0.0f, 0.0f);  // Initial position
    Vec<float, 3> v(1.0f, 1.0f, 0.0f);   // Initial velocity
    Vec<float, 3> a(0.0f, -9.8f, 0.0f);  // Gravity
    float t = 1.0f;                      // Time

    Vec<float, 3> position = p0 + v * t + a * (0.5f * t * t);

    // Expected: (1.0, 1.0 - 4.9, 0.0) = (1.0, -3.9, 0.0)
    zassert_true(float_eq(position.x(), 1.0f), "Projectile x failed");
    zassert_true(float_eq(position.y(), -3.9f), "Projectile y failed");
    zassert_true(float_eq(position.z(), 0.0f), "Projectile z failed");
}

// ===== Matrix-Vector Combined Operations =====

ZTEST(microla_integration, test_matrix_transform_chain)
{
    // Test applying multiple matrix transformations

    // Create scaling matrix (2x scale)
    Mat<float, 3, 3> scale{2.0f, 0.0f, 0.0f, 0.0f, 2.0f, 0.0f, 0.0f, 0.0f, 2.0f};

    // Create rotation matrix (identity for simplicity)
    auto rotation = Mat<float, 3, 3>::identity();

    // Combine transformations
    Mat<float, 3, 3> combined = scale * rotation;

    // Apply to vector
    Vec<float, 3> v(1.0f, 2.0f, 3.0f);
    Vec<float, 3> result = combined * v;

    // Should be scaled by 2
    zassert_true(float_eq(result.x(), 2.0f), "Transform chain x failed");
    zassert_true(float_eq(result.y(), 4.0f), "Transform chain y failed");
    zassert_true(float_eq(result.z(), 6.0f), "Transform chain z failed");
}

ZTEST(microla_integration, test_orthonormal_basis)
{
    // Verify orthonormal basis properties
    Vec<float, 3> u(1.0f, 0.0f, 0.0f);
    Vec<float, 3> v(0.0f, 1.0f, 0.0f);
    Vec<float, 3> w = u.cross(v);

    // Check orthogonality
    zassert_true(float_eq(u.dot(v), 0.0f), "Basis vectors not orthogonal");
    zassert_true(float_eq(u.dot(w), 0.0f), "Basis vectors not orthogonal");
    zassert_true(float_eq(v.dot(w), 0.0f), "Basis vectors not orthogonal");

    // Check normalization
    zassert_true(float_eq(u.magnitude(), 1.0f), "Basis vector not normalized");
    zassert_true(float_eq(v.magnitude(), 1.0f), "Basis vector not normalized");
    zassert_true(float_eq(w.magnitude(), 1.0f), "Basis vector not normalized");

    // w should be unit Z
    zassert_true(float_eq(w.z(), 1.0f), "Cross product failed to produce unit Z");
}

// ===== Performance/Stress Tests =====

ZTEST(microla_integration, test_multiple_operations)
{
    // Test a series of operations to ensure consistency
    Vec<float, 3> v(1.0f, 2.0f, 3.0f);

    // Apply multiple operations
    v = v * 2.0f;
    v = v + Vec<float, 3>(1.0f, 1.0f, 1.0f);
    v = v / 2.0f;

    // Expected: ((1,2,3)*2 + (1,1,1))/2 = ((2,4,6) + (1,1,1))/2 = (3,5,7)/2 = (1.5, 2.5, 3.5)
    zassert_true(float_eq(v.x(), 1.5f), "Multiple ops x failed");
    zassert_true(float_eq(v.y(), 2.5f), "Multiple ops y failed");
    zassert_true(float_eq(v.z(), 3.5f), "Multiple ops z failed");
}

ZTEST(microla_integration, test_constexpr_operations)
{
    // Test compile-time computations
#if defined(__ZEPHYR__)
    Vec<float, 3> v1(1.0f, 2.0f, 3.0f);
    Vec<float, 3> v2(4.0f, 5.0f, 6.0f);
    Vec<float, 3> sum = v1 + v2;
#else
    constexpr Vec<float, 3> v1(1.0f, 2.0f, 3.0f);
    constexpr Vec<float, 3> v2(4.0f, 5.0f, 6.0f);
    constexpr Vec<float, 3> sum = v1 + v2;
#endif

    zassert_true(float_eq(sum.x(), 5.0f), "Constexpr x failed");
    zassert_true(float_eq(sum.y(), 7.0f), "Constexpr y failed");
    zassert_true(float_eq(sum.z(), 9.0f), "Constexpr z failed");
}

// Test suite setup
ZTEST_SUITE(microla_integration, NULL, NULL, NULL, NULL, NULL);
```

## src/test_matrix.cpp
```c
// SPDX-License-Identifier: MIT
/// @file test_matrix.cpp
/// @brief Zephyr ztest tests for Mat<T,M,N> class
/// @copyright Copyright (c) 2026 James Baldwin

#include <zephyr/ztest.h>
#include <microla/microla.hpp>
#include <cmath>

using namespace microla;

static const float epsilon = 1e-5f;

// Helper function for floating point comparison
static bool float_eq(float a, float b, float eps = epsilon)
{
    return std::fabs(a - b) < eps;
}

// ===== Construction Tests =====

ZTEST(microla_matrix, test_default_constructor)
{
    Mat<float, 2, 2> m;
    for (size_t i = 0; i < 2; i++)
    {
        for (size_t j = 0; j < 2; j++)
        {
            zassert_true(float_eq(m(i, j), 0.0f), "Default constructor should initialize to zero");
        }
    }
}

ZTEST(microla_matrix, test_identity_matrix)
{
    auto m = Mat<float, 3, 3>::identity();

    // Diagonal elements should be 1
    zassert_true(float_eq(m(0, 0), 1.0f), "Identity diagonal [0,0] failed");
    zassert_true(float_eq(m(1, 1), 1.0f), "Identity diagonal [1,1] failed");
    zassert_true(float_eq(m(2, 2), 1.0f), "Identity diagonal [2,2] failed");

    // Off-diagonal elements should be 0
    zassert_true(float_eq(m(0, 1), 0.0f), "Identity off-diagonal failed");
    zassert_true(float_eq(m(0, 2), 0.0f), "Identity off-diagonal failed");
    zassert_true(float_eq(m(1, 0), 0.0f), "Identity off-diagonal failed");
}

ZTEST(microla_matrix, test_array_constructor)
{
    Mat<float, 2, 2> m{1.0f, 2.0f, 3.0f, 4.0f};

    zassert_true(float_eq(m(0, 0), 1.0f), "Array constructor [0,0] failed");
    zassert_true(float_eq(m(0, 1), 2.0f), "Array constructor [0,1] failed");
    zassert_true(float_eq(m(1, 0), 3.0f), "Array constructor [1,0] failed");
    zassert_true(float_eq(m(1, 1), 4.0f), "Array constructor [1,1] failed");
}

ZTEST(microla_matrix, test_copy_constructor)
{
    Mat<float, 2, 2> m1{1.0f, 2.0f, 3.0f, 4.0f};
    Mat<float, 2, 2> m2(m1);

    zassert_true(m1 == m2, "Copy constructor failed");
}

// ===== Accessor Tests =====

ZTEST(microla_matrix, test_element_access)
{
    Mat<float, 2, 2> m{1.0f, 2.0f, 3.0f, 4.0f};

    zassert_true(float_eq(m(0, 0), 1.0f), "Element access [0,0] failed");
    zassert_true(float_eq(m(0, 1), 2.0f), "Element access [0,1] failed");
    zassert_true(float_eq(m(1, 0), 3.0f), "Element access [1,0] failed");
    zassert_true(float_eq(m(1, 1), 4.0f), "Element access [1,1] failed");
}

ZTEST(microla_matrix, test_row_col_methods)
{
    auto m = Mat<float, 3, 3>::identity();

    zassert_equal(m.rows(), 3, "rows() method failed");
    zassert_equal(m.cols(), 3, "cols() method failed");
}

// ===== Arithmetic Operations =====

ZTEST(microla_matrix, test_matrix_addition)
{
    Mat<float, 2, 2> m1{1.0f, 2.0f, 3.0f, 4.0f};
    Mat<float, 2, 2> m2{5.0f, 6.0f, 7.0f, 8.0f};

    Mat<float, 2, 2> result = m1 + m2;

    zassert_true(float_eq(result(0, 0), 6.0f), "Matrix addition [0,0] failed");
    zassert_true(float_eq(result(0, 1), 8.0f), "Matrix addition [0,1] failed");
    zassert_true(float_eq(result(1, 0), 10.0f), "Matrix addition [1,0] failed");
    zassert_true(float_eq(result(1, 1), 12.0f), "Matrix addition [1,1] failed");
}

ZTEST(microla_matrix, test_matrix_subtraction)
{
    Mat<float, 2, 2> m1{5.0f, 6.0f, 7.0f, 8.0f};
    Mat<float, 2, 2> m2{1.0f, 2.0f, 3.0f, 4.0f};

    Mat<float, 2, 2> result = m1 - m2;

    zassert_true(float_eq(result(0, 0), 4.0f), "Matrix subtraction [0,0] failed");
    zassert_true(float_eq(result(0, 1), 4.0f), "Matrix subtraction [0,1] failed");
    zassert_true(float_eq(result(1, 0), 4.0f), "Matrix subtraction [1,0] failed");
    zassert_true(float_eq(result(1, 1), 4.0f), "Matrix subtraction [1,1] failed");
}

ZTEST(microla_matrix, test_scalar_multiplication)
{
    Mat<float, 2, 2> m{1.0f, 2.0f, 3.0f, 4.0f};

    Mat<float, 2, 2> result = m * 2.0f;

    zassert_true(float_eq(result(0, 0), 2.0f), "Scalar mult [0,0] failed");
    zassert_true(float_eq(result(0, 1), 4.0f), "Scalar mult [0,1] failed");
    zassert_true(float_eq(result(1, 0), 6.0f), "Scalar mult [1,0] failed");
    zassert_true(float_eq(result(1, 1), 8.0f), "Scalar mult [1,1] failed");
}

ZTEST(microla_matrix, test_matrix_multiplication)
{
    // Test 2x2 matrix multiplication
    Mat<float, 2, 2> m1{1.0f, 2.0f, 3.0f, 4.0f};
    Mat<float, 2, 2> m2{5.0f, 6.0f, 7.0f, 8.0f};

    Mat<float, 2, 2> result = m1 * m2;

    // [[1,2],[3,4]] * [[5,6],[7,8]] = [[19,22],[43,50]]
    zassert_true(float_eq(result(0, 0), 19.0f), "Matrix mult [0,0] failed");
    zassert_true(float_eq(result(0, 1), 22.0f), "Matrix mult [0,1] failed");
    zassert_true(float_eq(result(1, 0), 43.0f), "Matrix mult [1,0] failed");
    zassert_true(float_eq(result(1, 1), 50.0f), "Matrix mult [1,1] failed");
}

ZTEST(microla_matrix, test_matrix_vector_multiplication)
{
    Mat<float, 2, 2> m{1.0f, 2.0f, 3.0f, 4.0f};
    Vec<float, 2> v(5.0f, 6.0f);

    Vec<float, 2> result = m * v;

    // [[1,2],[3,4]] * [5,6] = [17,39]
    zassert_true(float_eq(result[0], 17.0f), "Matrix-vector mult [0] failed");
    zassert_true(float_eq(result[1], 39.0f), "Matrix-vector mult [1] failed");
}

// ===== Matrix Operations =====

ZTEST(microla_matrix, test_transpose)
{
    Mat<float, 2, 3> m{1.0f, 2.0f, 3.0f, 4.0f, 5.0f, 6.0f};

    Mat<float, 3, 2> result = m.transpose();

    zassert_true(float_eq(result(0, 0), 1.0f), "Transpose [0,0] failed");
    zassert_true(float_eq(result(0, 1), 4.0f), "Transpose [0,1] failed");
    zassert_true(float_eq(result(1, 0), 2.0f), "Transpose [1,0] failed");
    zassert_true(float_eq(result(1, 1), 5.0f), "Transpose [1,1] failed");
    zassert_true(float_eq(result(2, 0), 3.0f), "Transpose [2,0] failed");
    zassert_true(float_eq(result(2, 1), 6.0f), "Transpose [2,1] failed");
}

ZTEST(microla_matrix, test_determinant_2x2)
{
    Mat<float, 2, 2> m{1.0f, 2.0f, 3.0f, 4.0f};

    float det = m.determinant();

    // det = 1*4 - 2*3 = 4 - 6 = -2
    zassert_true(float_eq(det, -2.0f), "2x2 determinant failed");
}

ZTEST(microla_matrix, test_determinant_3x3)
{
    Mat<float, 3, 3> m{1.0f, 2.0f, 3.0f, 0.0f, 1.0f, 4.0f, 5.0f, 6.0f, 0.0f};

    float det = m.determinant();

    // det = 1*(1*0 - 4*6) - 2*(0*0 - 4*5) + 3*(0*6 - 1*5)
    //     = 1*(-24) - 2*(-20) + 3*(-5)
    //     = -24 + 40 - 15 = 1
    zassert_true(float_eq(det, 1.0f), "3x3 determinant failed");
}

ZTEST(microla_matrix, test_inverse_identity)
{
    auto m = Mat<float, 3, 3>::identity();
    auto inv = m.inverse();

    // Inverse of identity should be identity
    for (size_t i = 0; i < 3; i++)
    {
        for (size_t j = 0; j < 3; j++)
        {
            if (i == j)
            {
                zassert_true(float_eq(inv(i, j), 1.0f), "Identity inverse diagonal failed");
            }
            else
            {
                zassert_true(float_eq(inv(i, j), 0.0f), "Identity inverse off-diagonal failed");
            }
        }
    }
}

ZTEST(microla_matrix, test_inverse_2x2)
{
    Mat<float, 2, 2> m{1.0f, 2.0f, 3.0f, 4.0f};

    Mat<float, 2, 2> inv = m.inverse();
    Mat<float, 2, 2> product = m * inv;

    // Product should be approximately identity
    zassert_true(float_eq(product(0, 0), 1.0f, 1e-4f), "Inverse [0,0] failed");
    zassert_true(float_eq(product(0, 1), 0.0f, 1e-4f), "Inverse [0,1] failed");
    zassert_true(float_eq(product(1, 0), 0.0f, 1e-4f), "Inverse [1,0] failed");
    zassert_true(float_eq(product(1, 1), 1.0f, 1e-4f), "Inverse [1,1] failed");
}

// ===== Comparison Operations =====

ZTEST(microla_matrix, test_equality)
{
    Mat<float, 2, 2> m1{1.0f, 2.0f, 3.0f, 4.0f};
    Mat<float, 2, 2> m2{1.0f, 2.0f, 3.0f, 4.0f};

    zassert_true(m1 == m2, "Matrix equality failed");
}

ZTEST(microla_matrix, test_inequality)
{
    Mat<float, 2, 2> m1{1.0f, 2.0f, 3.0f, 4.0f};
    Mat<float, 2, 2> m2{5.0f, 6.0f, 7.0f, 8.0f};

    zassert_true(m1 != m2, "Matrix inequality failed");
}

// Test suite setup
ZTEST_SUITE(microla_matrix, NULL, NULL, NULL, NULL, NULL);
```

## src/test_matrix_view.cpp
```c
// SPDX-License-Identifier: MIT
/// @file test_matrix_view.cpp
/// @brief Zephyr ztest tests for MatrixView and ConstMatrixView
/// @copyright Copyright (c) 2026 James Baldwin

#include <zephyr/ztest.h>
#include <microla/microla.hpp>
#include <cmath>

using namespace microla;

static const float epsilon = 1e-6f;

static bool float_eq(float a, float b, float eps = epsilon)
{
    return std::fabs(a - b) < eps;
}

ZTEST(microla_matrix_view, test_read_and_write_parent)
{
    Mat<float, 4, 4> M;
    // fill parent with row-major incremental values
    for (std::uint32_t r = 0; r < 4; ++r)
    {
        for (std::uint32_t c = 0; c < 4; ++c)
        {
            M(r, c) = static_cast<float>(r * 10 + c);
        }
    }

    // create a 2x3 view starting at (1,1)
    MatrixView<float, 2, 3> view(M.data, M.cols(), 1, 1);

    // verify view reads correct parent values
    for (std::uint32_t r = 0; r < view.rows(); ++r)
    {
        for (std::uint32_t c = 0; c < view.cols(); ++c)
        {
            float expected = M(r + 1, c + 1);
            zassert_true(float_eq(view(r, c), expected), "View read mismatch");
        }
    }

    // write through view and verify parent changed
    view(0, 0) = 99.5f;
    zassert_true(float_eq(M(1, 1), 99.5f), "Write through view failed");
}

ZTEST(microla_matrix_view, test_set_copies_into_parent)
{
    Mat<float, 3, 2> source{1.0f, 2.0f, 3.0f, 4.0f, 5.0f, 6.0f};

    Mat<float, 4, 4> parent; // zero-initialized
    auto view = MatrixView<float, 3, 2>(parent.data, parent.cols(), 0, 1);

    view.set(source);

    // verify parent region contains source values
    for (std::uint32_t r = 0; r < 3; ++r)
    {
        for (std::uint32_t c = 0; c < 2; ++c)
        {
            zassert_true(float_eq(parent(r, c + 1), source(r, c)), "set() did not copy correctly");
        }
    }
}

ZTEST(microla_matrix_view, test_toMatrix_returns_copy)
{
    Mat<float, 4, 4> parent;
    for (std::uint32_t r = 0; r < 4; ++r)
    {
        for (std::uint32_t c = 0; c < 4; ++c)
        {
            parent(r, c) = static_cast<float>(r * 4 + c + 1);
        }
    }

    auto view = ConstMatrixView<float, 2, 2>(parent.data, parent.cols(), 2, 2);
    Mat<float, 2, 2> copy = view.toMatrix();

    // mutate parent and ensure copy does not change
    parent(2, 2) = -1.0f;
    zassert_true(!float_eq(copy(0, 0), parent(2, 2)), "toMatrix did not return an independent copy");

    // verify copy contents equal original region values
    zassert_true(float_eq(copy(0, 0), 9.0f), "toMatrix content mismatch");
}

ZTEST(microla_matrix_view, test_fill_works)
{
    Mat<float, 4, 4> parent;
    auto view = MatrixView<float, 2, 2>(parent.data, parent.cols(), 1, 2);

    view.fill(3.14f);

    for (std::uint32_t r = 0; r < 2; ++r)
    {
        for (std::uint32_t c = 0; c < 2; ++c)
        {
            zassert_true(float_eq(parent(r + 1, c + 2), 3.14f), "fill() did not populate parent region");
        }
    }
}

ZTEST(microla_matrix_view, test_const_view_toMatrix)
{
    Mat<float, 3, 3> parent{1.0f,2.0f,3.0f,4.0f,5.0f,6.0f,7.0f,8.0f,9.0f};
    const Mat<float, 3, 3>& cref = parent;

    ConstMatrixView<float, 2, 2> cview(cref.data, cref.cols(), 0, 0);
    Mat<float, 2, 2> m = cview.toMatrix();

    zassert_true(float_eq(m(0,0), 1.0f), "Const toMatrix value mismatch");
    zassert_true(float_eq(m(1,1), 5.0f), "Const toMatrix value mismatch");
}

ZTEST_SUITE(microla_matrix_view, NULL, NULL, NULL, NULL, NULL);
```

## src/test_quaternion.cpp
```c
// SPDX-License-Identifier: MIT
/// @file test_quaternion.cpp
/// @brief Zephyr ztest tests for Quaternion<T> class
/// @copyright Copyright (c) 2026 James Baldwin

#include <zephyr/ztest.h>
#include <microla/microla.hpp>
#include <cmath>

using namespace microla;

static const float epsilon = 1e-5f;
static const float PI = 3.14159265358979323846f;

// Helper function for floating point comparison
static bool float_eq(float a, float b, float eps = epsilon)
{
    return std::fabs(a - b) < eps;
}

// ===== Construction Tests =====

ZTEST(microla_quaternion, test_default_constructor)
{
    Quaternion<float> q;

    // Default should be identity quaternion (1, 0, 0, 0)
    zassert_true(float_eq(q.w(), 1.0f), "Default w should be 1");
    zassert_true(float_eq(q.x(), 0.0f), "Default x should be 0");
    zassert_true(float_eq(q.y(), 0.0f), "Default y should be 0");
    zassert_true(float_eq(q.z(), 0.0f), "Default z should be 0");
}

ZTEST(microla_quaternion, test_component_constructor)
{
    Quaternion<float> q(1.0f, 2.0f, 3.0f, 4.0f);

    zassert_true(float_eq(q.w(), 1.0f), "Component constructor w failed");
    zassert_true(float_eq(q.x(), 2.0f), "Component constructor x failed");
    zassert_true(float_eq(q.y(), 3.0f), "Component constructor y failed");
    zassert_true(float_eq(q.z(), 4.0f), "Component constructor z failed");
}

ZTEST(microla_quaternion, test_copy_constructor)
{
    Quaternion<float> q1(1.0f, 2.0f, 3.0f, 4.0f);
    Quaternion<float> q2(q1);

    zassert_true(q1 == q2, "Copy constructor failed");
}

// ===== Identity and Special Quaternions =====

ZTEST(microla_quaternion, test_identity)
{
    auto q = Quaternion<float>::identity();

    zassert_true(float_eq(q.w(), 1.0f), "Identity w should be 1");
    zassert_true(float_eq(q.x(), 0.0f), "Identity x should be 0");
    zassert_true(float_eq(q.y(), 0.0f), "Identity y should be 0");
    zassert_true(float_eq(q.z(), 0.0f), "Identity z should be 0");
}

// ===== Arithmetic Operations =====

ZTEST(microla_quaternion, test_addition)
{
    Quaternion<float> q1(1.0f, 2.0f, 3.0f, 4.0f);
    Quaternion<float> q2(5.0f, 6.0f, 7.0f, 8.0f);

    Quaternion<float> result = q1 + q2;

    zassert_true(float_eq(result.w(), 6.0f), "Addition w failed");
    zassert_true(float_eq(result.x(), 8.0f), "Addition x failed");
    zassert_true(float_eq(result.y(), 10.0f), "Addition y failed");
    zassert_true(float_eq(result.z(), 12.0f), "Addition z failed");
}

ZTEST(microla_quaternion, test_subtraction)
{
    Quaternion<float> q1(5.0f, 6.0f, 7.0f, 8.0f);
    Quaternion<float> q2(1.0f, 2.0f, 3.0f, 4.0f);

    Quaternion<float> result = q1 - q2;

    zassert_true(float_eq(result.w(), 4.0f), "Subtraction w failed");
    zassert_true(float_eq(result.x(), 4.0f), "Subtraction x failed");
    zassert_true(float_eq(result.y(), 4.0f), "Subtraction y failed");
    zassert_true(float_eq(result.z(), 4.0f), "Subtraction z failed");
}

ZTEST(microla_quaternion, test_scalar_multiplication)
{
    Quaternion<float> q(1.0f, 2.0f, 3.0f, 4.0f);
    Quaternion<float> result = q * 2.0f;

    zassert_true(float_eq(result.w(), 2.0f), "Scalar mult w failed");
    zassert_true(float_eq(result.x(), 4.0f), "Scalar mult x failed");
    zassert_true(float_eq(result.y(), 6.0f), "Scalar mult y failed");
    zassert_true(float_eq(result.z(), 8.0f), "Scalar mult z failed");
}

ZTEST(microla_quaternion, test_quaternion_multiplication)
{
    // Test with simple quaternions
    Quaternion<float> q1(1.0f, 0.0f, 1.0f, 0.0f);
    Quaternion<float> q2(1.0f, 0.5f, 0.5f, 0.75f);

    Quaternion<float> result = q1 * q2;

    // Quaternion multiplication is non-commutative
    // This test just ensures the operation executes without error
    // and produces a valid quaternion
    float norm_sq =
        result.w() * result.w() + result.x() * result.x() + result.y() * result.y() + result.z() * result.z();

    zassert_true(norm_sq > 0.0f, "Quaternion multiplication produced invalid result");
}

// ===== Quaternion Operations =====

ZTEST(microla_quaternion, test_norm)
{
    Quaternion<float> q(1.0f, 2.0f, 3.0f, 4.0f);
    float norm = q.norm();

    // sqrt(1 + 4 + 9 + 16) = sqrt(30)
    float expected = std::sqrt(30.0f);
    zassert_true(float_eq(norm, expected), "Norm calculation failed");
}

ZTEST(microla_quaternion, test_normalized)
{
    Quaternion<float> q(1.0f, 2.0f, 3.0f, 4.0f);
    Quaternion<float> normalized = q.normalized();

    float norm = normalized.norm();
    zassert_true(float_eq(norm, 1.0f), "Normalized quaternion should have norm 1");
}

ZTEST(microla_quaternion, test_conjugate)
{
    Quaternion<float> q(1.0f, 2.0f, 3.0f, 4.0f);
    Quaternion<float> conj = q.conjugate();

    zassert_true(float_eq(conj.w(), 1.0f), "Conjugate w should be unchanged");
    zassert_true(float_eq(conj.x(), -2.0f), "Conjugate x should be negated");
    zassert_true(float_eq(conj.y(), -3.0f), "Conjugate y should be negated");
    zassert_true(float_eq(conj.z(), -4.0f), "Conjugate z should be negated");
}

ZTEST(microla_quaternion, test_inverse)
{
    Quaternion<float> q(1.0f, 0.0f, 1.0f, 0.0f);
    Quaternion<float> q_inv = q.inverse();
    Quaternion<float> product = q * q_inv;

    // Product should be approximately identity
    zassert_true(float_eq(product.w(), 1.0f, 1e-4f), "Inverse w failed");
    zassert_true(float_eq(product.x(), 0.0f, 1e-4f), "Inverse x failed");
    zassert_true(float_eq(product.y(), 0.0f, 1e-4f), "Inverse y failed");
    zassert_true(float_eq(product.z(), 0.0f, 1e-4f), "Inverse z failed");
}

// ===== Rotation Tests =====

ZTEST(microla_quaternion, test_from_axis_angle)
{
    // 90 degree rotation around Z axis
    Vec<float, 3> axis(0.0f, 0.0f, 1.0f);
    float angle = PI / 2.0f;

    Quaternion<float> q = Quaternion<float>::from_axis_angle(axis, angle);

    // For 90 degrees around Z: w = cos(45°) ≈ 0.707, z = sin(45°) ≈ 0.707
    zassert_true(float_eq(q.w(), std::cos(angle / 2.0f), 1e-4f), "Axis-angle w failed");
    zassert_true(float_eq(q.x(), 0.0f, 1e-4f), "Axis-angle x failed");
    zassert_true(float_eq(q.y(), 0.0f, 1e-4f), "Axis-angle y failed");
    zassert_true(float_eq(q.z(), std::sin(angle / 2.0f), 1e-4f), "Axis-angle z failed");
}

ZTEST(microla_quaternion, test_rotate_vector)
{
    // 90 degree rotation around Z axis
    Vec<float, 3> axis(0.0f, 0.0f, 1.0f);
    float angle = PI / 2.0f;
    Quaternion<float> q = Quaternion<float>::from_axis_angle(axis, angle);

    // Rotate unit X vector
    Vec<float, 3> v(1.0f, 0.0f, 0.0f);
    Vec<float, 3> rotated = q.rotate(v);

    // Should become approximately unit Y vector
    zassert_true(float_eq(rotated.x(), 0.0f, 1e-4f), "Rotated x failed");
    zassert_true(float_eq(rotated.y(), 1.0f, 1e-4f), "Rotated y failed");
    zassert_true(float_eq(rotated.z(), 0.0f, 1e-4f), "Rotated z failed");
}

ZTEST(microla_quaternion, test_to_matrix)
{
    // Identity quaternion should produce identity matrix
    auto q = Quaternion<float>::identity();
    auto m = q.to_matrix();

    // Check diagonal elements
    zassert_true(float_eq(m(0, 0), 1.0f, 1e-4f), "Rotation matrix [0,0] failed");
    zassert_true(float_eq(m(1, 1), 1.0f, 1e-4f), "Rotation matrix [1,1] failed");
    zassert_true(float_eq(m(2, 2), 1.0f, 1e-4f), "Rotation matrix [2,2] failed");

    // Check off-diagonal elements
    zassert_true(float_eq(m(0, 1), 0.0f, 1e-4f), "Rotation matrix off-diagonal failed");
    zassert_true(float_eq(m(1, 0), 0.0f, 1e-4f), "Rotation matrix off-diagonal failed");
}

// ===== SLERP Test =====

ZTEST(microla_quaternion, test_slerp)
{
    auto q1 = Quaternion<float>::identity();
    Vec<float, 3> axis(0.0f, 0.0f, 1.0f);
    auto q2 = Quaternion<float>::from_axis_angle(axis, PI / 2.0f);

    // Interpolate half-way
    Quaternion<float> result = q1.slerp(q2, 0.5f);

    // Result should be a valid quaternion with norm ≈ 1
    float norm = result.norm();
    zassert_true(float_eq(norm, 1.0f, 1e-4f), "SLERP result should be normalized");
}

// ===== Comparison Operations =====

ZTEST(microla_quaternion, test_equality)
{
    Quaternion<float> q1(1.0f, 2.0f, 3.0f, 4.0f);
    Quaternion<float> q2(1.0f, 2.0f, 3.0f, 4.0f);

    zassert_true(q1 == q2, "Quaternion equality failed");
}

ZTEST(microla_quaternion, test_inequality)
{
    Quaternion<float> q1(1.0f, 2.0f, 3.0f, 4.0f);
    Quaternion<float> q2(5.0f, 6.0f, 7.0f, 8.0f);

    zassert_true(q1 != q2, "Quaternion inequality failed");
}

// Test suite setup
ZTEST_SUITE(microla_quaternion, NULL, NULL, NULL, NULL, NULL);
```

## src/test_vector.cpp
```c
// SPDX-License-Identifier: MIT
/// @file test_vector.cpp
/// @brief Zephyr ztest tests for Vec<T,N> class
/// @copyright Copyright (c) 2026 James Baldwin

#include <zephyr/ztest.h>
#include <microla/microla.hpp>
#include <cmath>

using namespace microla;

// Test vectors (using static to persist across test cases)
static Vec<float, 2> v2_zero(0.0f, 0.0f);
static Vec<float, 2> v2_ones(1.0f, 1.0f);
static Vec<float, 2> v2_a(3.0f, 4.0f);
static Vec<float, 2> v2_b(1.0f, 2.0f);

static Vec<float, 3> v3_zero(0.0f, 0.0f, 0.0f);
static Vec<float, 3> v3_unit_x(1.0f, 0.0f, 0.0f);
static Vec<float, 3> v3_unit_y(0.0f, 1.0f, 0.0f);
static Vec<float, 3> v3_unit_z(0.0f, 0.0f, 1.0f);
static Vec<float, 3> v3_a(1.0f, 2.0f, 3.0f);
static Vec<float, 3> v3_b(4.0f, 5.0f, 6.0f);

static Vec<float, 4> v4_a(1.0f, 2.0f, 3.0f, 4.0f);

static const float epsilon = 1e-6f;

// Helper function for floating point comparison
static bool float_eq(float a, float b, float eps = epsilon)
{
    return std::fabs(a - b) < eps;
}

// ===== Construction Tests =====

ZTEST(microla_vector, test_default_constructor)
{
    Vec<float, 3> v;
    zassert_true(float_eq(v[0], 0.0f), "Default constructor should initialize to zero");
    zassert_true(float_eq(v[1], 0.0f), "Default constructor should initialize to zero");
    zassert_true(float_eq(v[2], 0.0f), "Default constructor should initialize to zero");
}

ZTEST(microla_vector, test_variadic_constructor)
{
    Vec<float, 3> v(1.0f, 2.0f, 3.0f);
    zassert_true(float_eq(v[0], 1.0f), "Variadic constructor x failed");
    zassert_true(float_eq(v[1], 2.0f), "Variadic constructor y failed");
    zassert_true(float_eq(v[2], 3.0f), "Variadic constructor z failed");
}

ZTEST(microla_vector, test_copy_constructor)
{
    Vec<float, 3> v1(1.0f, 2.0f, 3.0f);
    Vec<float, 3> v2(v1);
    zassert_true(v1 == v2, "Copy constructor failed");
}

ZTEST(microla_vector, test_array_constructor)
{
    float arr[] = {1.0f, 2.0f, 3.0f};
    Vec<float, 3> v(arr);
    zassert_true(float_eq(v[0], 1.0f), "Array constructor x failed");
    zassert_true(float_eq(v[1], 2.0f), "Array constructor y failed");
    zassert_true(float_eq(v[2], 3.0f), "Array constructor z failed");
}

// ===== Accessor Tests =====

ZTEST(microla_vector, test_subscript_operator)
{
    zassert_true(float_eq(v3_a[0], 1.0f), "Subscript [0] failed");
    zassert_true(float_eq(v3_a[1], 2.0f), "Subscript [1] failed");
    zassert_true(float_eq(v3_a[2], 3.0f), "Subscript [2] failed");
}

ZTEST(microla_vector, test_component_accessors)
{
    zassert_true(float_eq(v3_a.x(), 1.0f), "x() accessor failed");
    zassert_true(float_eq(v3_a.y(), 2.0f), "y() accessor failed");
    zassert_true(float_eq(v3_a.z(), 3.0f), "z() accessor failed");
    zassert_true(float_eq(v4_a.w(), 4.0f), "w() accessor failed");
}

ZTEST(microla_vector, test_size_method)
{
    zassert_equal(v2_a.size(), 2, "Vec2 size should be 2");
    zassert_equal(v3_a.size(), 3, "Vec3 size should be 3");
    zassert_equal(v4_a.size(), 4, "Vec4 size should be 4");
}

// ===== Arithmetic Operations =====

ZTEST(microla_vector, test_addition)
{
    Vec<float, 3> result = v3_a + v3_b;
    zassert_true(float_eq(result[0], 5.0f), "Addition x failed");
    zassert_true(float_eq(result[1], 7.0f), "Addition y failed");
    zassert_true(float_eq(result[2], 9.0f), "Addition z failed");
}

ZTEST(microla_vector, test_subtraction)
{
    Vec<float, 3> result = v3_b - v3_a;
    zassert_true(float_eq(result[0], 3.0f), "Subtraction x failed");
    zassert_true(float_eq(result[1], 3.0f), "Subtraction y failed");
    zassert_true(float_eq(result[2], 3.0f), "Subtraction z failed");
}

ZTEST(microla_vector, test_scalar_multiplication)
{
    Vec<float, 3> result = v3_a * 2.0f;
    zassert_true(float_eq(result[0], 2.0f), "Scalar mult x failed");
    zassert_true(float_eq(result[1], 4.0f), "Scalar mult y failed");
    zassert_true(float_eq(result[2], 6.0f), "Scalar mult z failed");
}

ZTEST(microla_vector, test_scalar_division)
{
    Vec<float, 3> result = v3_a / 2.0f;
    zassert_true(float_eq(result[0], 0.5f), "Scalar div x failed");
    zassert_true(float_eq(result[1], 1.0f), "Scalar div y failed");
    zassert_true(float_eq(result[2], 1.5f), "Scalar div z failed");
}

// ===== Vector Operations =====

ZTEST(microla_vector, test_dot_product)
{
    float result = v3_a.dot(v3_b);
    // 1*4 + 2*5 + 3*6 = 4 + 10 + 18 = 32
    zassert_true(float_eq(result, 32.0f), "Dot product failed");
}

ZTEST(microla_vector, test_cross_product)
{
    Vec<float, 3> result = v3_unit_x.cross(v3_unit_y);
    zassert_true(float_eq(result[0], 0.0f), "Cross product x failed");
    zassert_true(float_eq(result[1], 0.0f), "Cross product y failed");
    zassert_true(float_eq(result[2], 1.0f), "Cross product z failed");
}

ZTEST(microla_vector, test_magnitude)
{
    float mag = v2_a.magnitude();
    // sqrt(3^2 + 4^2) = sqrt(9 + 16) = sqrt(25) = 5
    zassert_true(float_eq(mag, 5.0f), "Magnitude failed");
}

ZTEST(microla_vector, test_normalize)
{
    Vec<float, 3> normalized = v3_a.normalized();
    float mag = normalized.magnitude();
    zassert_true(float_eq(mag, 1.0f), "Normalized vector should have magnitude 1");
}

ZTEST(microla_vector, test_magnitude_squared)
{
    float mag_sq = v2_a.magnitude_squared();
    // 3^2 + 4^2 = 9 + 16 = 25
    zassert_true(float_eq(mag_sq, 25.0f), "Magnitude squared failed");
}

// ===== Comparison Operations =====

ZTEST(microla_vector, test_equality)
{
    Vec<float, 3> v1(1.0f, 2.0f, 3.0f);
    Vec<float, 3> v2(1.0f, 2.0f, 3.0f);
    zassert_true(v1 == v2, "Equality operator failed");
}

ZTEST(microla_vector, test_inequality)
{
    zassert_true(v3_a != v3_b, "Inequality operator failed");
}

// ===== Compound Assignment =====

ZTEST(microla_vector, test_add_assign)
{
    Vec<float, 3> v(1.0f, 2.0f, 3.0f);
    v += Vec<float, 3>(1.0f, 1.0f, 1.0f);
    zassert_true(float_eq(v[0], 2.0f), "Add assign x failed");
    zassert_true(float_eq(v[1], 3.0f), "Add assign y failed");
    zassert_true(float_eq(v[2], 4.0f), "Add assign z failed");
}

ZTEST(microla_vector, test_subtract_assign)
{
    Vec<float, 3> v(4.0f, 5.0f, 6.0f);
    v -= Vec<float, 3>(1.0f, 1.0f, 1.0f);
    zassert_true(float_eq(v[0], 3.0f), "Subtract assign x failed");
    zassert_true(float_eq(v[1], 4.0f), "Subtract assign y failed");
    zassert_true(float_eq(v[2], 5.0f), "Subtract assign z failed");
}

ZTEST(microla_vector, test_multiply_assign)
{
    Vec<float, 3> v(1.0f, 2.0f, 3.0f);
    v *= 2.0f;
    zassert_true(float_eq(v[0], 2.0f), "Multiply assign x failed");
    zassert_true(float_eq(v[1], 4.0f), "Multiply assign y failed");
    zassert_true(float_eq(v[2], 6.0f), "Multiply assign z failed");
}

// Test suite setup
ZTEST_SUITE(microla_vector, NULL, NULL, NULL, NULL, NULL);
```

## src/test_vector_view.cpp
```c
// SPDX-License-Identifier: Apache-2.0
/// @file test_vector_view.cpp
/// @brief Zephyr ztest tests for VectorView and ConstVectorView

#include <zephyr/ztest.h>
#include <microla/microla.hpp>

using namespace microla;

static const float epsilon_v = 1e-6F;

static bool float_eq_v(float a, float b, float eps = epsilon_v)
{
    return std::fabs(a - b) < eps;
}

ZTEST(microla_vector_view, test_read_and_write_parent)
{
    Vec<float, 4> parent;
    for (std::size_t i = 0; i < 4; ++i)
    {
        parent[i] = static_cast<float>(i);
    }

    VectorView<float, 2> view(parent.data, 4, 1);
    zassert_true(float_eq_v(view[0], parent[1]), "View read mismatch");

    view[0] = 11.5F;
    zassert_true(float_eq_v(parent[1], 11.5F), "Write through view failed");
}

ZTEST(microla_vector_view, test_set_copies_into_parent)
{
    Vec<float, 3> source;
    source[0] = 1.0F;
    source[1] = 2.0F;
    source[2] = 3.0F;

    Vec<float, 5> parent;
    for (std::size_t i = 0; i < 5; ++i)
    {
        parent[i] = 0.0F;
    }

    VectorView<float, 3> view(parent.data, 5, 1);
    view.set(source);

    for (std::size_t i = 0; i < 3; ++i)
    {
        zassert_true(float_eq_v(parent[1 + i], source[i]), "set() did not copy correctly");
    }
}

ZTEST(microla_vector_view, test_toVec_returns_copy)
{
    Vec<float, 5> parent;
    for (std::size_t i = 0; i < 5; ++i)
    {
        parent[i] = static_cast<float>(i + 1);
    }

    ConstVectorView<float, 2> cview(parent.data, 5, 2);
    Vec<float, 2> copy = cview.to_vec();

    parent[2] = -1.0F;
    zassert_true(!float_eq_v(copy[0], parent[2]), "toVec did not return an independent copy");
    zassert_true(float_eq_v(copy[0], 3.0F), "toVec content mismatch");
}

ZTEST_SUITE(microla_vector_view, NULL, NULL, NULL, NULL, NULL);
```
